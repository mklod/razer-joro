## CMakeLists.txt
```
# Last modified: 2026-04-10--0400
cmake_minimum_required(VERSION 3.20.0)
find_package(Zephyr REQUIRED HINTS $ENV{ZEPHYR_BASE})
project(ble_mitm_proxy)

target_sources(app PRIVATE
  src/main.c
  src/central.c
  src/peripheral.c
  src/relay.c
)
```

## prj.conf
```kconfig
# Last modified: 2026-04-10--0400
# BLE MITM Proxy for Razer Joro keyboard

# BLE core
CONFIG_BT=y
CONFIG_BT_CENTRAL=y
CONFIG_BT_PERIPHERAL=y
CONFIG_BT_GATT_CLIENT=y
CONFIG_BT_MAX_CONN=3
CONFIG_BT_DEVICE_NAME="Joro"
CONFIG_BT_DEVICE_NAME_DYNAMIC=y
CONFIG_BT_GATT_DYNAMIC_DB=y

# Enable pairing so Windows can bond with us
CONFIG_BT_SMP=y
CONFIG_BT_BONDABLE=y
# Persist bonds across resets
CONFIG_BT_SETTINGS=y
CONFIG_SETTINGS=y
CONFIG_SETTINGS_RUNTIME=y
CONFIG_NVS=y
CONFIG_FLASH=y
CONFIG_FLASH_MAP=y
CONFIG_FLASH_PAGE_LAYOUT=y

# Extended advertising support (Joro might use BLE 5.x features)
CONFIG_BT_EXT_ADV=y

# Device Information Service — Synapse checks VID/PID before using custom service
CONFIG_BT_DIS=y
CONFIG_BT_DIS_PNP=y
CONFIG_BT_DIS_PNP_VID_SRC=2
CONFIG_BT_DIS_PNP_VID=0x068E
CONFIG_BT_DIS_PNP_PID=0x02CE
CONFIG_BT_DIS_PNP_VER=0x0001
CONFIG_BT_DIS_MANUF="Razer"
CONFIG_BT_DIS_MODEL="Joro"

# Battery service
CONFIG_BT_BAS=y

# Increase buffer counts for relay
CONFIG_BT_L2CAP_TX_BUF_COUNT=10
CONFIG_BT_ATT_TX_COUNT=10
CONFIG_BT_BUF_ACL_TX_COUNT=7
CONFIG_BT_BUF_EVT_RX_COUNT=10

# USB CDC serial for logging
CONFIG_USB_DEVICE_STACK=y
CONFIG_USB_DEVICE_PRODUCT="Joro-MITM-Proxy"
CONFIG_USB_DEVICE_VID=0x2FE3
CONFIG_SERIAL=y
CONFIG_CONSOLE=y
CONFIG_UART_CONSOLE=y
CONFIG_UART_LINE_CTRL=y

# Logging — RTT as primary (doesn't need USB working), CDC as secondary
CONFIG_LOG=y
CONFIG_LOG_MODE_DEFERRED=y
CONFIG_LOG_BUFFER_SIZE=4096
CONFIG_LOG_PROCESS_THREAD_STACK_SIZE=2048
CONFIG_PRINTK=y
CONFIG_USE_SEGGER_RTT=y
CONFIG_LOG_BACKEND_RTT=y
CONFIG_LOG_BACKEND_RTT_MODE_DROP=y
CONFIG_RTT_CONSOLE=y
CONFIG_SEGGER_RTT_BUFFER_SIZE_UP=4096

# Override board default — we flash directly via SWD, no MBR/bootloader
CONFIG_FLASH_LOAD_OFFSET=0x0

# Stack sizes — BLE + USB + logging needs generous stacks
CONFIG_MAIN_STACK_SIZE=4096
CONFIG_SYSTEM_WORKQUEUE_STACK_SIZE=4096
CONFIG_BT_RX_STACK_SIZE=8192
CONFIG_BT_HCI_TX_STACK_SIZE=4096
CONFIG_ISR_STACK_SIZE=4096
```

## src/main.c
```c
// Last modified: 2026-04-10--1710
// BLE MITM Proxy — main entry point
// Effect test: static, breathing 1+2 color, spectrum cycling

#include <zephyr/kernel.h>
#include <zephyr/bluetooth/bluetooth.h>
#include <zephyr/bluetooth/conn.h>
#include <zephyr/usb/usb_device.h>
#include <zephyr/drivers/uart.h>
#include <zephyr/logging/log.h>

#include <zephyr/settings/settings.h>

#include "central.h"
#include "peripheral.h"
#include "relay.h"

LOG_MODULE_REGISTER(mitm_main, LOG_LEVEL_INF);

static void connected_cb(struct bt_conn *conn, uint8_t err)
{
	char addr[BT_ADDR_LE_STR_LEN];
	bt_addr_le_to_str(bt_conn_get_dst(conn), addr, sizeof(addr));

	LOG_INF("*** connected_cb: addr=%s err=0x%02x", addr, err);

	if (err) {
		LOG_ERR("Connection failed: %s (err 0x%02x)", addr, err);
		return;
	}

	/* Determine if this is upstream (keyboard) or downstream (PC) */
	struct bt_conn_info info;
	bt_conn_get_info(conn, &info);

	if (info.role == BT_CONN_ROLE_CENTRAL) {
		LOG_INF(">>> UPSTREAM connected: %s (we are central -> keyboard)", addr);
		relay_set_upstream(conn);
		/* Start GATT discovery on the keyboard */
		central_discover_services(conn);
		/* Now start advertising so Synapse can find us */
		peripheral_start_adv();
	} else {
		LOG_INF("<<< DOWNSTREAM connected: %s (Synapse connected to us)", addr);
		relay_set_downstream(conn);
	}
}

static void disconnected_cb(struct bt_conn *conn, uint8_t reason)
{
	char addr[BT_ADDR_LE_STR_LEN];
	bt_addr_le_to_str(bt_conn_get_dst(conn), addr, sizeof(addr));

	struct bt_conn_info info;
	bt_conn_get_info(conn, &info);

	if (info.role == BT_CONN_ROLE_CENTRAL) {
		LOG_INF(">>> UPSTREAM disconnected: %s (reason 0x%02x)", addr, reason);
		relay_set_upstream(NULL);
		/* Restart scanning for the keyboard */
		central_start_scan();
	} else {
		LOG_INF("<<< DOWNSTREAM disconnected: %s (reason 0x%02x)", addr, reason);
		relay_set_downstream(NULL);
		/* Restart advertising for Synapse */
		peripheral_start_adv();
	}
}

/* --- SMP Pairing Auth Callbacks --- */

static void auth_passkey_display(struct bt_conn *conn, unsigned int passkey)
{
	LOG_INF("SMP: Passkey display: %06u", passkey);
}

static void auth_passkey_confirm(struct bt_conn *conn, unsigned int passkey)
{
	LOG_INF("SMP: Passkey confirm: %06u — auto-accepting", passkey);
	bt_conn_auth_passkey_confirm(conn);
}

static void auth_cancel(struct bt_conn *conn)
{
	LOG_INF("SMP: Pairing cancelled");
}

static void auth_pairing_confirm(struct bt_conn *conn)
{
	LOG_INF("SMP: Pairing confirm requested — accepting");
	bt_conn_auth_pairing_confirm(conn);
}

static void auth_pairing_complete(struct bt_conn *conn, bool bonded)
{
	LOG_INF("SMP: Pairing complete, bonded=%d", bonded);
}

static void auth_pairing_failed(struct bt_conn *conn, enum bt_security_err reason)
{
	LOG_ERR("SMP: Pairing FAILED, reason=%u", reason);
}

static struct bt_conn_auth_cb auth_cb = {
	.passkey_display = auth_passkey_display,
	.passkey_confirm = auth_passkey_confirm,
	.cancel = auth_cancel,
	.pairing_confirm = auth_pairing_confirm,
};

static struct bt_conn_auth_info_cb auth_info_cb = {
	.pairing_complete = auth_pairing_complete,
	.pairing_failed = auth_pairing_failed,
};

/* --- Connection Callbacks --- */

static void security_changed_cb(struct bt_conn *conn, bt_security_t level,
				enum bt_security_err err)
{
	char addr[BT_ADDR_LE_STR_LEN];
	bt_addr_le_to_str(bt_conn_get_dst(conn), addr, sizeof(addr));
	LOG_INF("*** Security changed: %s level=%u err=%u", addr, level, err);
}

BT_CONN_CB_DEFINE(conn_callbacks) = {
	.connected = connected_cb,
	.disconnected = disconnected_cb,
	.security_changed = security_changed_cb,
};

int main(void)
{
	int err;

	/* Enable USB CDC for serial logging */
	err = usb_enable(NULL);
	if (err && err != -EALREADY) {
		LOG_ERR("USB enable failed: %d", err);
	}

	/* Give USB a moment to enumerate */
	k_sleep(K_MSEC(1000));

	LOG_INF("=== Joro BLE MITM Proxy ===");
	LOG_INF("Firmware built " __DATE__ " " __TIME__);

	/* Register SMP auth callbacks for pairing negotiation */
	bt_conn_auth_cb_register(&auth_cb);
	bt_conn_auth_info_cb_register(&auth_info_cb);

	/* Enable Bluetooth */
	err = bt_enable(NULL);
	if (err) {
		LOG_ERR("BT enable failed: %d", err);
		return err;
	}

	/* Load settings (bond info, identity) from flash */
	settings_load();
	LOG_INF("BT enabled, settings loaded");

	/* Start both: advertise for Synapse AND scan for keyboard */
	peripheral_start_adv();
	central_start_scan();

	LOG_INF("Proxy running — advertising + scanning");
	LOG_INF("  Advertising as 'Joro' for Synapse");
	LOG_INF("  Scanning for real Joro keyboard");

	/* Main loop — wait for upstream, then run probe test */
	bool test_done = false;
	while (1) {
		k_sleep(K_SECONDS(2));
		relay_print_stats();

		if (!test_done && relay_upstream_connected()) {
			/* Wait for GATT discovery + notification subscription */
			k_sleep(K_SECONDS(3));
			if (!relay_upstream_connected()) continue;

			LOG_INF("=============================================");
			LOG_INF("=== SET COMMAND TEST — with SMP pairing   ===");
			LOG_INF("=============================================");
			test_done = true;

			static uint8_t txn = 0;

			/* --- PHASE 0: Request BLE encryption --- */
			LOG_INF("--- P0: Requesting BLE encryption ---");
			{
				struct bt_conn *up = relay_get_upstream_conn();
				if (up) {
					int sec_err = bt_conn_set_security(up, BT_SECURITY_L2);
					LOG_INF("Security L2 request: err=%d", sec_err);
					k_sleep(K_SECONDS(3));  /* Give SMP time to negotiate */
				}
			}

			/* --- PHASE 1: Driver init sequence (from HCI capture) --- */
			LOG_INF("--- P1: Driver init sequence ---");

			/* GET 0x01/0xA0 — sent twice by driver on connect */
			uint8_t init1[] = {++txn, 0,0,0, 0x01,0xA0, 0,0};
			central_write_to_keyboard(init1, 8);
			LOG_INF("[%02x] INIT: GET 0x01/0xA0 (1st)", txn);
			k_sleep(K_MSEC(600));

			uint8_t init2[] = {++txn, 0,0,0, 0x01,0xA0, 0,0};
			central_write_to_keyboard(init2, 8);
			LOG_INF("[%02x] INIT: GET 0x01/0xA0 (2nd)", txn);
			k_sleep(K_MSEC(600));

			/* GET 0x05/0x87 sub=00,01 */
			uint8_t init3[] = {++txn, 0,0,0, 0x05,0x87, 0x00,0x01};
			central_write_to_keyboard(init3, 8);
			LOG_INF("[%02x] INIT: GET 0x05/0x87 sub=00,01", txn);
			k_sleep(K_MSEC(600));

			/* GET 0x05/0x84 */
			uint8_t init4[] = {++txn, 0,0,0, 0x05,0x84, 0,0};
			central_write_to_keyboard(init4, 8);
			LOG_INF("[%02x] INIT: GET 0x05/0x84", txn);
			k_sleep(K_MSEC(600));

			/* SET 0x05/0x07 sub=00,01 data=[00] — driver config (SPLIT write) */
			{
				uint8_t hdr[] = {++txn, 0x01,0,0, 0x05,0x07, 0x00,0x01};
				uint8_t dat[] = {0x00};
				central_write_split(hdr, 8, dat, 1);
				LOG_INF("[%02x] INIT: SET 0x05/0x07 sub=00,01 d=[00] (split)", txn);
			}
			k_sleep(K_MSEC(600));

			/* --- PHASE 2: GET current state --- */
			LOG_INF("--- P2: Read current state ---");

			uint8_t g_brt[] = {++txn, 0,0,0, 0x10,0x85, 0,0};
			central_write_to_keyboard(g_brt, 8);
			LOG_INF("[%02x] GET brightness 0x10/0x85", txn);
			k_sleep(K_MSEC(600));

			uint8_t g_light[] = {++txn, 0,0,0, 0x10,0x83, 0,0};
			central_write_to_keyboard(g_light, 8);
			LOG_INF("[%02x] GET lighting 0x10/0x83", txn);
			k_sleep(K_MSEC(600));

			/* --- PHASE 3: Brightness MAX --- */
			LOG_INF("--- P3: Brightness MAX ---");
			{
				uint8_t hdr[] = {++txn, 0x01,0,0, 0x10,0x05, 0x01,0x00};
				uint8_t dat[] = {0xFF};
				central_write_split(hdr, 8, dat, 1);
				LOG_INF("[%02x] SET BRT MAX", txn);
			}
			k_sleep(K_SECONDS(1));

			/* --- PHASE 4: EFFECTS with correct variable-length data --- */
			LOG_INF("--- P4: EFFECT TEST (correct formats from HCI capture) ---");
			LOG_INF(">>> WATCH THE KEYBOARD <<<");

			/* 1. Static RED (dlen=7) */
			{
				uint8_t hdr[] = {++txn, 0x07,0,0, 0x10,0x03, 0x01,0x00};
				uint8_t dat[] = {0x01, 0x00, 0x00, 0x01, 0xFF, 0x00, 0x00};
				central_write_split(hdr, 8, dat, 7);
				LOG_INF("[%02x] STATIC RED", txn);
			}
			k_sleep(K_SECONDS(4));

			/* 2. Breathing BLUE — 1 color (dlen=7) */
			{
				uint8_t hdr[] = {++txn, 0x07,0,0, 0x10,0x03, 0x01,0x00};
				uint8_t dat[] = {0x02, 0x01, 0x00, 0x01, 0x00, 0x00, 0xFF};
				central_write_split(hdr, 8, dat, 7);
				LOG_INF("[%02x] BREATHING BLUE (1 color)", txn);
			}
			k_sleep(K_SECONDS(8));

			/* 3. Breathing RED+GREEN — 2 colors (dlen=10) */
			{
				uint8_t hdr[] = {++txn, 0x0A,0,0, 0x10,0x03, 0x01,0x00};
				uint8_t dat[] = {0x02, 0x02, 0x00, 0x02,
					0xFF, 0x00, 0x00,   /* color 1: red */
					0x00, 0xFF, 0x00};   /* color 2: green */
				central_write_split(hdr, 8, dat, 10);
				LOG_INF("[%02x] BREATHING RED+GREEN (2 color)", txn);
			}
			k_sleep(K_SECONDS(8));

			/* 4. Spectrum cycling (dlen=4) */
			{
				uint8_t hdr[] = {++txn, 0x04,0,0, 0x10,0x03, 0x01,0x00};
				uint8_t dat[] = {0x03, 0x00, 0x00, 0x00};
				central_write_split(hdr, 8, dat, 4);
				LOG_INF("[%02x] SPECTRUM CYCLING", txn);
			}
			k_sleep(K_SECONDS(8));

			/* 5. Static GREEN (back to simple) */
			{
				uint8_t hdr[] = {++txn, 0x07,0,0, 0x10,0x03, 0x01,0x00};
				uint8_t dat[] = {0x01, 0x00, 0x00, 0x01, 0x00, 0xFF, 0x00};
				central_write_split(hdr, 8, dat, 7);
				LOG_INF("[%02x] STATIC GREEN", txn);
			}
			k_sleep(K_SECONDS(3));

			/* 6. Static PURPLE (final) */
			{
				uint8_t hdr[] = {++txn, 0x07,0,0, 0x10,0x03, 0x01,0x00};
				uint8_t dat[] = {0x01, 0x00, 0x00, 0x01, 0x80, 0x00, 0xFF};
				central_write_split(hdr, 8, dat, 7);
				LOG_INF("[%02x] STATIC PURPLE", txn);
			}
			k_sleep(K_SECONDS(3));

			/* Read final state */
			uint8_t g_light2[] = {++txn, 0,0,0, 0x10,0x83, 0,0};
			central_write_to_keyboard(g_light2, 8);
			LOG_INF("[%02x] GET final lighting state", txn);
			k_sleep(K_MSEC(600));

			LOG_INF("=============================================");
			LOG_INF("=== SET COMMAND TEST COMPLETE             ===");
			LOG_INF("=============================================");
		}
	}

	return 0;
}
```

## src/central.c
```c
// Last modified: 2026-04-10--1700
// Central role — scan for and connect to the real Joro keyboard,
// discover GATT services, subscribe to notifications

#include <zephyr/kernel.h>
#include <zephyr/bluetooth/bluetooth.h>
#include <zephyr/bluetooth/conn.h>
#include <zephyr/bluetooth/gatt.h>
#include <zephyr/bluetooth/uuid.h>
#include <zephyr/logging/log.h>

#include "central.h"
#include "relay.h"

LOG_MODULE_REGISTER(central, LOG_LEVEL_INF);

/* Razer custom service UUID: 52401523-f97c-7f90-0e7f-6c6f4e36db1c */
static struct bt_uuid_128 razer_svc_uuid = BT_UUID_INIT_128(
	BT_UUID_128_ENCODE(0x52401523, 0xf97c, 0x7f90, 0x0e7f, 0x6c6f4e36db1c));

/* Characteristic UUIDs */
static struct bt_uuid_128 char_1524_uuid = BT_UUID_INIT_128(
	BT_UUID_128_ENCODE(0x52401524, 0xf97c, 0x7f90, 0x0e7f, 0x6c6f4e36db1c));
static struct bt_uuid_128 char_1525_uuid = BT_UUID_INIT_128(
	BT_UUID_128_ENCODE(0x52401525, 0xf97c, 0x7f90, 0x0e7f, 0x6c6f4e36db1c));
static struct bt_uuid_128 char_1526_uuid = BT_UUID_INIT_128(
	BT_UUID_128_ENCODE(0x52401526, 0xf97c, 0x7f90, 0x0e7f, 0x6c6f4e36db1c));

/* Discovered handle for the write characteristic (1524) */
static uint16_t write_handle;

/* Connection to the real keyboard */
static struct bt_conn *kb_conn;

/* Subscription state */
static struct bt_gatt_subscribe_params sub_1525;
static struct bt_gatt_subscribe_params sub_1526;

/* Discovery state */
static struct bt_gatt_discover_params discover_params;
static enum {
	DISC_STATE_SVC,
	DISC_STATE_CHAR,
	DISC_STATE_DONE,
} disc_state;

static uint8_t connect_attempts;
#define MAX_CONNECT_ATTEMPTS 10

/* Forward declarations */
static uint8_t discover_cb(struct bt_conn *conn,
			    const struct bt_gatt_attr *attr,
			    struct bt_gatt_discover_params *params);

/* --- Notification callbacks --- */

static uint8_t notify_1525_cb(struct bt_conn *conn,
			      struct bt_gatt_subscribe_params *params,
			      const void *data, uint16_t length)
{
	if (!data) {
		LOG_INF("1525 subscription ended");
		return BT_GATT_ITER_STOP;
	}
	relay_keyboard_notify_1525(data, length);
	return BT_GATT_ITER_CONTINUE;
}

static uint8_t notify_1526_cb(struct bt_conn *conn,
			      struct bt_gatt_subscribe_params *params,
			      const void *data, uint16_t length)
{
	if (!data) {
		LOG_INF("1526 subscription ended");
		return BT_GATT_ITER_STOP;
	}
	relay_keyboard_notify_1526(data, length);
	return BT_GATT_ITER_CONTINUE;
}

/* --- GATT Discovery --- */

static uint16_t svc_start_handle;
static uint16_t svc_end_handle;

static void subscribe_to_char(struct bt_conn *conn, uint16_t value_handle,
			      struct bt_gatt_subscribe_params *sub,
			      bt_gatt_notify_func_t cb, const char *name)
{
	sub->notify = cb;
	sub->value_handle = value_handle;
	/* CCC handle is typically value_handle + 1 */
	sub->ccc_handle = value_handle + 1;
	sub->value = BT_GATT_CCC_NOTIFY;
	atomic_set_bit(sub->flags, BT_GATT_SUBSCRIBE_FLAG_VOLATILE);

	int err = bt_gatt_subscribe(conn, sub);
	if (err && err != -EALREADY) {
		LOG_ERR("Subscribe %s failed: %d", name, err);
	} else {
		LOG_INF("Subscribed to %s (handle %u)", name, value_handle);
	}
}

static uint8_t discover_cb(struct bt_conn *conn,
			    const struct bt_gatt_attr *attr,
			    struct bt_gatt_discover_params *params)
{
	if (!attr) {
		if (disc_state == DISC_STATE_SVC) {
			LOG_ERR("Razer custom service not found on keyboard!");
			return BT_GATT_ITER_STOP;
		}
		/* Characteristic discovery complete */
		LOG_INF("GATT discovery complete. Write handle=%u", write_handle);
		disc_state = DISC_STATE_DONE;
		return BT_GATT_ITER_STOP;
	}

	if (disc_state == DISC_STATE_SVC) {
		/* Found the service — record handle range */
		struct bt_gatt_service_val *svc = attr->user_data;
		svc_start_handle = attr->handle;
		svc_end_handle = svc->end_handle;
		LOG_INF("Found Razer service: handles %u-%u",
			svc_start_handle, svc_end_handle);

		/* Now discover characteristics within this service */
		disc_state = DISC_STATE_CHAR;
		discover_params.uuid = NULL; /* all characteristics */
		discover_params.start_handle = svc_start_handle + 1;
		discover_params.end_handle = svc_end_handle;
		discover_params.type = BT_GATT_DISCOVER_CHARACTERISTIC;
		discover_params.func = discover_cb;

		int err = bt_gatt_discover(conn, &discover_params);
		if (err) {
			LOG_ERR("Char discovery failed: %d", err);
		}
		return BT_GATT_ITER_STOP;
	}

	if (disc_state == DISC_STATE_CHAR) {
		struct bt_gatt_chrc *chrc = attr->user_data;
		char uuid_str[BT_UUID_STR_LEN];
		bt_uuid_to_str(chrc->uuid, uuid_str, sizeof(uuid_str));
		LOG_INF("  Char: %s handle=%u props=0x%02x",
			uuid_str, chrc->value_handle, chrc->properties);

		if (!bt_uuid_cmp(chrc->uuid, &char_1524_uuid.uuid)) {
			write_handle = chrc->value_handle;
			LOG_INF("  -> 1524 (write/command) handle=%u", write_handle);
		} else if (!bt_uuid_cmp(chrc->uuid, &char_1525_uuid.uuid)) {
			LOG_INF("  -> 1525 (notify/response) handle=%u", chrc->value_handle);
			subscribe_to_char(conn, chrc->value_handle,
					  &sub_1525, notify_1525_cb, "1525");
		} else if (!bt_uuid_cmp(chrc->uuid, &char_1526_uuid.uuid)) {
			LOG_INF("  -> 1526 (notify/secondary) handle=%u", chrc->value_handle);
			subscribe_to_char(conn, chrc->value_handle,
					  &sub_1526, notify_1526_cb, "1526");
		}
		return BT_GATT_ITER_CONTINUE;
	}

	return BT_GATT_ITER_STOP;
}

void central_discover_services(struct bt_conn *conn)
{
	LOG_INF("Starting GATT discovery on keyboard...");

	kb_conn = conn;
	disc_state = DISC_STATE_SVC;
	write_handle = 0;

	discover_params.uuid = &razer_svc_uuid.uuid;
	discover_params.start_handle = BT_ATT_FIRST_ATTRIBUTE_HANDLE;
	discover_params.end_handle = BT_ATT_LAST_ATTRIBUTE_HANDLE;
	discover_params.type = BT_GATT_DISCOVER_PRIMARY;
	discover_params.func = discover_cb;

	int err = bt_gatt_discover(conn, &discover_params);
	if (err) {
		LOG_ERR("Service discovery failed: %d", err);
	}
}

/* --- Write to keyboard --- */

/* Write completion callback for bt_gatt_write */
static volatile bool write_done;
static volatile int write_err;

static void write_cb(struct bt_conn *conn, uint8_t err,
		     struct bt_gatt_write_params *params)
{
	write_err = err;
	write_done = true;
	if (err) {
		LOG_ERR("GATT write failed: err=%u", err);
	}
}

static struct bt_gatt_write_params write_params;

int central_write_to_keyboard(const uint8_t *data, uint16_t len)
{
	if (!kb_conn || !write_handle) {
		return -ENOTCONN;
	}

	/* Use ATT Write Request (opcode 0x12), NOT Write Without Response.
	 * The keyboard's char 1524 has props=0x08 (Write only, no WwoR).
	 * The Razer driver uses Write Request — keyboard may reject WwoR for SET cmds. */
	write_params.handle = write_handle;
	write_params.offset = 0;
	write_params.data = data;
	write_params.length = len;
	write_params.func = write_cb;
	write_done = false;

	int err = bt_gatt_write(kb_conn, &write_params);
	if (err) {
		return err;
	}

	/* Wait for write completion (with timeout) */
	for (int i = 0; i < 100 && !write_done; i++) {
		k_sleep(K_MSEC(10));
	}
	if (!write_done) {
		LOG_ERR("GATT write timeout (1s)");
		return -ETIMEDOUT;
	}
	return write_err;
}

int central_write_split(const uint8_t *hdr, uint16_t hdr_len,
			const uint8_t *data, uint16_t data_len)
{
	/* Send Protocol30 command as SPLIT writes (like Razer driver):
	 *   Write 1: 8-byte header
	 *   Write 2: data payload (separate ATT Write Request)
	 * This is required for SET commands — concatenated writes return FAILURE. */
	int err;

	/* Write header */
	err = central_write_to_keyboard(hdr, hdr_len);
	if (err) {
		LOG_ERR("Split write: header failed: %d", err);
		return err;
	}

	if (data_len > 0 && data != NULL) {
		/* Wait between split writes — keyboard needs time to process header
		 * before receiving data. Driver showed ~100-200ms gap. */
		k_sleep(K_MSEC(150));

		/* Write data payload */
		err = central_write_to_keyboard(data, data_len);
		if (err) {
			LOG_ERR("Split write: data failed: %d", err);
			return err;
		}
	}

	/* Wait for keyboard to process the complete command */
	k_sleep(K_MSEC(100));
	return 0;
}

/* --- Scanning --- */

static bool is_joro_device(struct bt_data *data, void *user_data)
{
	bool *found = user_data;

	if (data->type == BT_DATA_NAME_COMPLETE ||
	    data->type == BT_DATA_NAME_SHORTENED) {
		if (data->data_len >= 4 &&
		    memcmp(data->data, "Joro", 4) == 0) {
			*found = true;
			return false; /* stop parsing */
		}
	}
	return true; /* continue */
}

static void scan_cb(const bt_addr_le_t *addr, int8_t rssi,
		    uint8_t type, struct net_buf_simple *ad)
{
	bool found = false;
	char addr_str[BT_ADDR_LE_STR_LEN];

	bt_data_parse(ad, is_joro_device, &found);
	if (!found) {
		return;
	}

	bt_addr_le_to_str(addr, addr_str, sizeof(addr_str));

	if (connect_attempts >= MAX_CONNECT_ATTEMPTS) {
		/* Stop hammering — log and wait for manual reset */
		return;
	}

	LOG_INF("Found Joro: %s (RSSI %d, type=%u, attempt %u/%u)",
		addr_str, rssi, type, connect_attempts + 1, MAX_CONNECT_ATTEMPTS);

	/* Only connect to connectable advertisements */
	if (type != BT_GAP_ADV_TYPE_ADV_IND &&
	    type != BT_GAP_ADV_TYPE_ADV_DIRECT_IND) {
		LOG_WRN("  Not connectable (type=%u), skipping", type);
		return;
	}

	connect_attempts++;

	/* Stop scanning and advertising before connecting —
	 * simultaneous adv+connect can cause radio conflicts */
	bt_le_adv_stop();
	int err = bt_le_scan_stop();
	if (err) {
		LOG_ERR("Scan stop failed: %d", err);
		return;
	}

	/* Connect to the keyboard — use longer interval and supervision timeout
	 * to be more tolerant of the link-layer handshake */
	struct bt_conn *conn = NULL;
	static struct bt_le_conn_param conn_param = {
		.interval_min = 24,   /* 30ms */
		.interval_max = 40,   /* 50ms */
		.latency = 0,
		.timeout = 400,       /* 4.0s — very generous supervision timeout */
	};
	struct bt_le_conn_param *param = &conn_param;

	err = bt_conn_le_create(addr, BT_CONN_LE_CREATE_CONN, param, &conn);
	if (err) {
		LOG_ERR("Connect to keyboard failed: %d", err);
		/* Restart scanning */
		central_start_scan();
		return;
	}

	/* Connection ref will be handled in connected callback */
	bt_conn_unref(conn);
}

void central_start_scan(void)
{
	struct bt_le_scan_param scan_param = {
		.type = BT_LE_SCAN_TYPE_PASSIVE,
		.options = BT_LE_SCAN_OPT_NONE,
		.interval = BT_GAP_SCAN_FAST_INTERVAL,
		.window = BT_GAP_SCAN_FAST_WINDOW,
	};

	int err = bt_le_scan_start(&scan_param, scan_cb);
	if (err) {
		LOG_ERR("Scan start failed: %d", err);
	} else {
		LOG_INF("Scanning for Joro keyboard...");
	}
}
```

## src/central.h
```c
// Last modified: 2026-04-10--0400
#ifndef CENTRAL_H
#define CENTRAL_H

#include <zephyr/bluetooth/conn.h>

/* Start scanning for the real Joro keyboard */
void central_start_scan(void);

/* Discover GATT services on the keyboard after connection */
void central_discover_services(struct bt_conn *conn);

/* Write data to the keyboard's command characteristic (1524) */
int central_write_to_keyboard(const uint8_t *data, uint16_t len);

/* Split write: header then data as separate ATT Write Requests */
int central_write_split(const uint8_t *hdr, uint16_t hdr_len,
			const uint8_t *data, uint16_t data_len);

#endif
```

## src/peripheral.c
```c
// Last modified: 2026-04-10--0400
// Peripheral role — advertise as "Joro", mirror the Razer custom GATT service,
// receive writes from Synapse and forward to relay

#include <zephyr/kernel.h>
#include <zephyr/bluetooth/bluetooth.h>
#include <zephyr/bluetooth/gatt.h>
#include <zephyr/bluetooth/uuid.h>
#include <zephyr/logging/log.h>

#include "peripheral.h"
#include "relay.h"

LOG_MODULE_REGISTER(peripheral, LOG_LEVEL_INF);

/* Razer custom service UUID: 52401523-f97c-7f90-0e7f-6c6f4e36db1c */
#define RAZER_SVC_UUID \
	BT_UUID_128_ENCODE(0x52401523, 0xf97c, 0x7f90, 0x0e7f, 0x6c6f4e36db1c)
#define RAZER_1524_UUID \
	BT_UUID_128_ENCODE(0x52401524, 0xf97c, 0x7f90, 0x0e7f, 0x6c6f4e36db1c)
#define RAZER_1525_UUID \
	BT_UUID_128_ENCODE(0x52401525, 0xf97c, 0x7f90, 0x0e7f, 0x6c6f4e36db1c)
#define RAZER_1526_UUID \
	BT_UUID_128_ENCODE(0x52401526, 0xf97c, 0x7f90, 0x0e7f, 0x6c6f4e36db1c)

static struct bt_uuid_128 svc_uuid = BT_UUID_INIT_128(RAZER_SVC_UUID);
static struct bt_uuid_128 char_1524 = BT_UUID_INIT_128(RAZER_1524_UUID);
static struct bt_uuid_128 char_1525 = BT_UUID_INIT_128(RAZER_1525_UUID);
static struct bt_uuid_128 char_1526 = BT_UUID_INIT_128(RAZER_1526_UUID);

/* Buffers for readable characteristic values */
static uint8_t val_1525[20];
static uint8_t val_1526[8];

/* --- Characteristic callbacks --- */

/* 1524: Write from PC (command channel) */
static ssize_t write_1524_cb(struct bt_conn *conn,
			     const struct bt_gatt_attr *attr,
			     const void *buf, uint16_t len,
			     uint16_t offset, uint8_t flags)
{
	LOG_INF("PC wrote to 1524: %u bytes", len);
	relay_pc_write(buf, len);
	return len;
}

/* 1525: Read from PC */
static ssize_t read_1525_cb(struct bt_conn *conn,
			    const struct bt_gatt_attr *attr,
			    void *buf, uint16_t len,
			    uint16_t offset)
{
	return bt_gatt_attr_read(conn, attr, buf, len, offset,
				 val_1525, sizeof(val_1525));
}

/* 1526: Read from PC */
static ssize_t read_1526_cb(struct bt_conn *conn,
			    const struct bt_gatt_attr *attr,
			    void *buf, uint16_t len,
			    uint16_t offset)
{
	return bt_gatt_attr_read(conn, attr, buf, len, offset,
				 val_1526, sizeof(val_1526));
}

/* --- GATT Service Definition ---
 * Mirror the real Joro's Razer custom service exactly:
 *   1524 — write (command input)
 *   1525 — read + notify (response, 20 bytes)
 *   1526 — read + notify (secondary, 8 bytes)
 */
BT_GATT_SERVICE_DEFINE(razer_svc,
	BT_GATT_PRIMARY_SERVICE(&svc_uuid),

	/* 1524: write characteristic */
	BT_GATT_CHARACTERISTIC(&char_1524.uuid,
		BT_GATT_CHRC_WRITE | BT_GATT_CHRC_WRITE_WITHOUT_RESP,
		BT_GATT_PERM_WRITE,
		NULL, write_1524_cb, NULL),

	/* 1525: read + notify characteristic */
	BT_GATT_CHARACTERISTIC(&char_1525.uuid,
		BT_GATT_CHRC_READ | BT_GATT_CHRC_NOTIFY,
		BT_GATT_PERM_READ,
		read_1525_cb, NULL, NULL),
	BT_GATT_CCC(NULL, BT_GATT_PERM_READ | BT_GATT_PERM_WRITE),

	/* 1526: read + notify characteristic */
	BT_GATT_CHARACTERISTIC(&char_1526.uuid,
		BT_GATT_CHRC_READ | BT_GATT_CHRC_NOTIFY,
		BT_GATT_PERM_READ,
		read_1526_cb, NULL, NULL),
	BT_GATT_CCC(NULL, BT_GATT_PERM_READ | BT_GATT_PERM_WRITE),
);

/* --- Advertising --- */

static const struct bt_data ad[] = {
	BT_DATA_BYTES(BT_DATA_FLAGS,
		      BT_LE_AD_GENERAL | BT_LE_AD_NO_BREDR),
	BT_DATA(BT_DATA_NAME_COMPLETE, "Joro", 4),
};

static const struct bt_data sd[] = {
	BT_DATA_BYTES(BT_DATA_UUID128_ALL, RAZER_SVC_UUID),
};

void peripheral_start_adv(void)
{
	int err = bt_le_adv_start(BT_LE_ADV_CONN_FAST_2, ad, ARRAY_SIZE(ad),
				  sd, ARRAY_SIZE(sd));
	if (err) {
		LOG_ERR("Advertising start failed: %d", err);
	} else {
		LOG_INF("Advertising as 'Joro'");
	}
}

/* --- Notify downstream (PC) --- */

int peripheral_notify_1525(const uint8_t *data, uint16_t len)
{
	/* Update stored value */
	uint16_t copy_len = MIN(len, sizeof(val_1525));
	memcpy(val_1525, data, copy_len);

	/* Find the 1525 attribute — it's the 4th in the service definition
	 * (service, 1524 decl, 1524 val, 1525 decl, 1525 val) */
	const struct bt_gatt_attr *attr =
		&razer_svc.attrs[4]; /* 1525 value attr */

	return bt_gatt_notify(NULL, attr, data, len);
}

int peripheral_notify_1526(const uint8_t *data, uint16_t len)
{
	uint16_t copy_len = MIN(len, sizeof(val_1526));
	memcpy(val_1526, data, copy_len);

	/* 1526 value attr: after 1525's CCC descriptor */
	const struct bt_gatt_attr *attr =
		&razer_svc.attrs[7]; /* 1526 value attr */

	return bt_gatt_notify(NULL, attr, data, len);
}
```

## src/peripheral.h
```c
// Last modified: 2026-04-10--0400
#ifndef PERIPHERAL_H
#define PERIPHERAL_H

/* Start advertising as "Joro" */
void peripheral_start_adv(void);

/* Send notification to downstream (PC/Synapse) on char 1525 */
int peripheral_notify_1525(const uint8_t *data, uint16_t len);

/* Send notification to downstream (PC/Synapse) on char 1526 */
int peripheral_notify_1526(const uint8_t *data, uint16_t len);

#endif
```

## src/relay.c
```c
// Last modified: 2026-04-10--1650
// Relay layer — forwards traffic between upstream (keyboard) and downstream (PC)
// Logs all GATT operations in hex for protocol analysis

#include <zephyr/kernel.h>
#include <zephyr/bluetooth/bluetooth.h>
#include <zephyr/bluetooth/conn.h>
#include <zephyr/logging/log.h>

#include "relay.h"
#include "central.h"
#include "peripheral.h"

LOG_MODULE_REGISTER(relay, LOG_LEVEL_INF);

static struct bt_conn *upstream_conn;   /* keyboard */
static struct bt_conn *downstream_conn; /* PC/Synapse */
static uint32_t pc_writes;
static uint32_t kb_notif_1525;
static uint32_t kb_notif_1526;

static void log_hex(const char *prefix, const uint8_t *data, uint16_t len)
{
	/* Print hex dump for protocol analysis */
	printk("%s [%u bytes]:", prefix, len);
	for (uint16_t i = 0; i < len; i++) {
		printk(" %02x", data[i]);
	}
	printk("\n");
}

void relay_set_upstream(struct bt_conn *conn)
{
	if (upstream_conn) {
		bt_conn_unref(upstream_conn);
	}
	upstream_conn = conn ? bt_conn_ref(conn) : NULL;
}

void relay_set_downstream(struct bt_conn *conn)
{
	if (downstream_conn) {
		bt_conn_unref(downstream_conn);
	}
	downstream_conn = conn ? bt_conn_ref(conn) : NULL;
}

void relay_pc_write(const uint8_t *data, uint16_t len)
{
	pc_writes++;
	log_hex("PC->KB WRITE", data, len);

	if (!upstream_conn) {
		LOG_WRN("PC->KB: no upstream connection, dropping");
		return;
	}

	int err = central_write_to_keyboard(data, len);
	if (err) {
		LOG_ERR("PC->KB: write failed: %d", err);
	}
}

void relay_keyboard_notify_1525(const uint8_t *data, uint16_t len)
{
	kb_notif_1525++;
	log_hex("KB->PC NOTIFY 1525", data, len);

	if (!downstream_conn) {
		LOG_WRN("KB->PC 1525: no downstream connection, dropping");
		return;
	}

	int err = peripheral_notify_1525(data, len);
	if (err) {
		LOG_ERR("KB->PC 1525: notify failed: %d", err);
	}
}

void relay_keyboard_notify_1526(const uint8_t *data, uint16_t len)
{
	kb_notif_1526++;
	log_hex("KB->PC NOTIFY 1526", data, len);

	if (!downstream_conn) {
		LOG_WRN("KB->PC 1526: no downstream connection, dropping");
		return;
	}

	int err = peripheral_notify_1526(data, len);
	if (err) {
		LOG_ERR("KB->PC 1526: notify failed: %d", err);
	}
}

bool relay_upstream_connected(void)
{
	return upstream_conn != NULL;
}

struct bt_conn *relay_get_upstream_conn(void)
{
	return upstream_conn;
}

void relay_print_stats(void)
{
	LOG_INF("Stats: PC->KB writes=%u, KB->PC 1525=%u, KB->PC 1526=%u, "
		"upstream=%s, downstream=%s",
		pc_writes, kb_notif_1525, kb_notif_1526,
		upstream_conn ? "connected" : "none",
		downstream_conn ? "connected" : "none");
}
```

## src/relay.h
```c
// Last modified: 2026-04-10--0400
#ifndef RELAY_H
#define RELAY_H

#include <zephyr/bluetooth/conn.h>

/* Set/clear connection references */
void relay_set_upstream(struct bt_conn *conn);
void relay_set_downstream(struct bt_conn *conn);

/* Called when PC writes to our peripheral (forward to keyboard) */
void relay_pc_write(const uint8_t *data, uint16_t len);

/* Called when keyboard sends notification on 1525 (forward to PC) */
void relay_keyboard_notify_1525(const uint8_t *data, uint16_t len);

/* Called when keyboard sends notification on 1526 (forward to PC) */
void relay_keyboard_notify_1526(const uint8_t *data, uint16_t len);

/* Print relay statistics */
void relay_print_stats(void);

/* Check if upstream (keyboard) is connected */
bool relay_upstream_connected(void);

/* Get upstream connection reference (for security requests etc.) */
struct bt_conn *relay_get_upstream_conn(void);

#endif
```
